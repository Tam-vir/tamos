OUTPUT_ARCH(riscv)
ENTRY(_start)


SECTIONS
{
    /*==================================
                RAM Start
    ==================================*/

    . = 0x80000000;

    _memory_start = .;


    /*==================================
                Text Section
    ==================================*/

    .text :
    {
        *(.text)
        *(.text.*)
    }


    /*==================================
               Read Only Data
    ==================================*/

    .rodata :
    {
        *(.rodata)
        *(.rodata.*)
    }


    /*==================================
                  Data
    ==================================*/

    .data :
    {
        *(.data)
        *(.data.*)
    }


    /*==================================
                  BSS
    ==================================*/

    .bss :
    {
        _bss_start = .;

        *(.bss)
        *(.bss.*)
        *(COMMON)

        _bss_end = .;
    }


    /*==================================
                Kernel Heap
    ==================================*/

    . = ALIGN(4096);

    _heap_start = .;

    /*
        Reserve 4 MB for the kernel heap.
    */

    . += (4 * 1024 * 1024);

    _heap_end = .;


    /*==================================
                Memory End
    ==================================*/

    _memory_end = .;
}
